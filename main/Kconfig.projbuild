## main/Kconfig.projbuild
```kconfig
menu "LED Strip ESP32 Configuration"

	config CONFIG_PATH
		string "JSON configuration file path"
		default "config.json"
		help
			Path relative to main directory to the config.json file to be used for configuration.

endmenu
```

## sdkconfig.defaults
```kconfig
CONFIG_PARTITION_TABLE_SINGLE_APP=n
CONFIG_PARTITION_TABLE_SINGLE_APP_LARGE=y

CONFIG_LWIP_LOCAL_HOSTNAME="ledstripesp32"

CONFIG_LOG_DEFAULT_LEVEL_INFO=n
CONFIG_LOG_DEFAULT_LEVEL_DEBUG=y
CONFIG_LOG_DEFAULT_LEVEL=4
CONFIG_LOG_MAXIMUM_EQUALS_DEFAULT=y
```
